## config/west.yml
```yaml
manifest:
  defaults:
    revision: main
  remotes:
    - name: urob
      url-base: https://github.com/urob
  projects:
    - name: zmk
      remote: urob
      revision: display-support
      import: app/west.yml
  self:
    path: config
```
