&i2c1 {
    compatible = "nordic,nrf-twi";
    status = "okay";
    scl-pin = <26>;
    sda-pin = <27>;

    ssd1306@3c {
        compatible = "solomon,ssd1306fb";
        reg = <0x3c>;
        label = "SSD1306";
        width = <128>;
        height = <32>;
        segment-offset = <0>;
        page-offset = <0>;
        display-offset = <0>;
        multiplex-ratio = <31>;
        segment-remap = <1>;
        com-invert = <0>;
        precharge-period = <2>;
        com-pins-hw-config = <2>;
        contrast = <127>;
        vcom-deselect = <0>;
        i2c-max-frequency = <400000>;
    };
};
